## drivers/wifi/st67w611m1/Kconfig.st67w611m1
```kconfig
# Copyright (c) 2026 STMicroelectronics
# SPDX-License-Identifier: Apache-2.0

menuconfig ST67W611M1
	bool "ST67W611M1 base"
	default y
	depends on DT_HAS_ST_ST67W611M1_ENABLED
	select MODEM
	select MODEM_CONTEXT
	select MODEM_CMD_HANDLER
	select GPIO
	select SPI
	select SPI_STM32_DMA if SOC_FAMILY_STM32

if ST67W611M1

config WIFI_ST67W611M1
	bool "ST67W611M1 Wi-Fi driver"
	default y
	select NET_L2_ETHERNET # Wifi driver is defined as an Ethernet interface
	select WIFI_USE_NATIVE_NETWORKING # Set net_wifi_mgmt_offload as an ethernet_api

config ST67W611M1_SCAN_RESULT_MAX_NUMBER
	int "Max number of scan results"
	default 12

config ST67W611M1_WORKQ_THREAD_PRIORITY
	int "Priority of the work queue thread"
	default 7

config ST67W611M1_WORKQ_STACK_SIZE
	int "Stack size of the driver work queue"
	default 1024

config ST67W611M1_RX_THREAD_PRIORITY
	int "Priority of the RX thread"
	default 7

config ST67W611M1_RX_THREAD_STACK_SIZE
	int "Stack size of the RX thread"
	default 1024

config ST67W611M1_SPI_PROCESSOR_THREAD_PRIORITY
	int "Priority of the thread processing the SPI TX and RX transfers"
	default 8

config ST67W611M1_SPI_PROCESSOR_THREAD_STACK_SIZE
	int "Stack size of the SPI TX RX transfer thread"
	default 1024

config ST67W611M1_TX_BUF_COUNT
	int "Number of max len SPI frames that can fit in the TX message queue"
	default 4

config ST67W611M1_RX_BUF_COUNT
	int "Number of max len AT cmds that can fit in the RX message queue"
	default 4

config NET_MGMT_EVENT_STACK_SIZE
	default 2048

endif # ST67W611M1
```

## dts/bindings/wifi/st,st67w611m1.yaml
```yaml
# Copyright (c) 2026 STMicroelectronics
# SPDX-License-Identifier: Apache-2.0

description: ST67W611M1 Wi-Fi module

compatible: "st,st67w611m1"

include: spi-device.yaml

properties:
  chip-select-gpios:
    type: phandle-array
    required: true

  ready-gpios:
    type: phandle-array
    required: true

  chip-en-gpios:
    type: phandle-array
    required: true

  boot-gpios:
    type: phandle-array
    required: true
```
